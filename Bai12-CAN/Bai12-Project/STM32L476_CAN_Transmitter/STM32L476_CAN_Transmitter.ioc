# file: STM32L476_CAN_Transmitter.ioc
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Mcu.Family=STM32L4
Mcu.Name=STM32L476R(C-E-G)Tx
Mcu.Package=LQFP64
NVIC.PriorityGroup=NVIC_PRIORITYGROUP_4
PC13.GPIO_Label=PushButton
PC13.GPIO_PuPd=GPIO_PULLUP
PC13.Signal=GPIO_Input
PC14-OSC32_IN\ (PC14).Mode=LSE-External-Oscillator
PC14-OSC32_IN\ (PC14).Signal=RCC_OSC32_IN
PC15-OSC32_OUT\ (PC15).Mode=LSE-External-Oscillator
PC15-OSC32_OUT\ (PC15).Signal=RCC_OSC32_OUT
PH0-OSC_IN\ (PH0).Signal=RCC_OSC_IN
PH1-OSC_OUT\ (PH1).Signal=RCC_OSC_OUT
ProjectManager.HeapSize=0x200
ProjectManager.StackSize=0x400
ProjectManager.TargetToolchain=MDK-ARM V5.32
RCC.ADCFreq_Value=16000000
RCC.AHBFreq_Value=45000000
RCC.APB1Freq_Value=45000000
RCC.APB1TimFreq_Value=45000000
RCC.APB2Freq_Value=45000000
RCC.APB2TimFreq_Value=45000000
RCC.CortexFreq_Value=45000000
RCC.HCLKFreq_Value=45000000
RCC.HSE_VALUE=8000000
RCC.HSI_VALUE=16000000
RCC.MSI_VALUE=4000000
RCC.PLLN=45
RCC.PLLR=RCC_PLLR_DIV4
RCC.PREFETCH_ENABLE=1
RCC.SYSCLKFreq_VALUE=45000000
RCC.SYSCLKSource=RCC_SYSCLKSOURCE_PLLCLK
RCC.USBFreq_Value=16000000
RCC.VCOOutputFreq_Value=180000000
TIM2.Period=9
TIM2.Prescaler=399
VP_TIM2_VS_ClockSourceINT.Mode=Internal
board=NUCLEO-L476RG

// file: Src/main.c
/* USER CODE BEGIN Header */
/**
  ******************************************************************************
  * @file           : main.c
  * @brief          : Main program body
  ******************************************************************************
  * @attention
  *
  * Copyright (c) 2024 STMicroelectronics.
  * All rights reserved.
  *
  * This software is licensed under terms that can be found in the LICENSE file
  * in the root directory of this software component.
  * If no LICENSE file comes with this software, it is provided AS-IS.
  *
  ******************************************************************************
  */
/* USER CODE END Header */
#include "main.h"

/* USER CODE BEGIN Includes */
#include "CANBus_L476.h"
#include "stdlib.h"
/* USER CODE END Includes */

/* USER CODE BEGIN PV */
CANBusTxFrameDef txFrame;
CANBusRxFrameDef rxFrame;
/* USER CODE END PV */

void SystemClock_Config(void);
static void MX_GPIO_Init(void);
static void MX_TIM2_Init(void);
/* USER CODE BEGIN PFP */
void delay_ms(uint32_t timeDelay);
int ButtonPressed(void);
/* USER CODE END PFP */

int main(void)
{

  /* MCU Configuration--------------------------------------------------------*/

  /* Reset of all peripherals, Initializes the Flash interface and the Systick. */
  LL_APB2_GRP1_EnableClock(LL_APB2_GRP1_PERIPH_SYSCFG);
  LL_APB1_GRP1_EnableClock(LL_APB1_GRP1_PERIPH_PWR);

  /* System interrupt init*/
  NVIC_SetPriorityGrouping(NVIC_PRIORITYGROUP_4);

  /* Configure the system clock */
  SystemClock_Config();

  /* Initialize all configured peripherals */
  MX_GPIO_Init();
  MX_TIM2_Init();
  /* USER CODE BEGIN 2 */
	CANBus_L476_Pins_Init();
	CANBus_L476_Init();
	CANBus_L476_Filter_Configuration();
	CANBus_L476_Start();
  /* USER CODE END 2 */
	LL_mDelay(100);

//	txFrame.identifier = 0x011;    // Standard ID
//	txFrame.length = 8;            // 8 bytes of data
//	txFrame.data[0] = 0x55;
//	txFrame.data[1] = 0x44;
//	txFrame.data[2] = 0x33;
//	txFrame.data[3] = 0x22;
//	txFrame.data[4] = 0x22;
//	txFrame.data[5] = 0x33;
//	txFrame.data[6] = 0x44;
//	txFrame.data[7] = 0x55;
//
//	CANBus_L476_SendMessage(&txFrame);
//
//	LL_mDelay(2000);
//
	txFrame.identifier = 0x00;    // Standard ID
	txFrame.length = 8;            // 8 bytes of data
	txFrame.data[0] = 0xAA;
	txFrame.data[1] = 0xBB;
	txFrame.data[2] = 0xCC;
	txFrame.data[3] = 0xDD;
	txFrame.data[4] = 0x11;
	txFrame.data[5] = 0x22;
	txFrame.data[6] = 0x33;
	txFrame.data[7] = 0x44;

  //CANBus_L476_SendMessage(&txFrame);
	/*
	for (int i=0;i<8;i++)
		{
			TXFrame.data[i]=i;
		}

		TXFrame.identifier=0x1AD;
		TXFrame.length=8;
		CANBus_L476_SendMessage( &TXFrame );
		LL_mDelay(1000);
		*/
  /* Infinite loop */
  while (1)
  {
    /* USER CODE BEGIN 3 */
		if(ButtonPressed())
		{
			if (txFrame.identifier == 0x1A1)
			{
				txFrame.identifier = 0x4A3;
				CANBus_L476_SendMessage(&txFrame);
			}
			else if (txFrame.identifier == 0x4A3)
			{
				txFrame.identifier = 0x5A1;
				CANBus_L476_SendMessage(&txFrame);
			}
			else if (txFrame.identifier == 0x5A1 || txFrame.identifier == 0x00)
			{
				txFrame.identifier = 0x1A1;
				CANBus_L476_SendMessage(&txFrame);
			}
		}
  }
  /* USER CODE END 3 */
}

void SystemClock_Config(void)
{
  LL_FLASH_SetLatency(LL_FLASH_LATENCY_2);
  while(LL_FLASH_GetLatency()!= LL_FLASH_LATENCY_2)
  {
  }
  LL_PWR_SetRegulVoltageScaling(LL_PWR_REGU_VOLTAGE_SCALE1);
  while (LL_PWR_IsActiveFlag_VOS() != 0)
  {
  }
  LL_RCC_MSI_Enable();

   /* Wait till MSI is ready */
  while(LL_RCC_MSI_IsReady() != 1)
  {

  }
  LL_RCC_MSI_EnableRangeSelection();
  LL_RCC_MSI_SetRange(LL_RCC_MSIRANGE_6);
  LL_RCC_MSI_SetCalibTrimming(0);
  LL_PWR_EnableBkUpAccess();
  LL_RCC_LSE_SetDriveCapability(LL_RCC_LSEDRIVE_LOW);
  LL_RCC_LSE_Enable();

   /* Wait till LSE is ready */
  while(LL_RCC_LSE_IsReady() != 1)
  {

  }
  LL_RCC_MSI_EnablePLLMode();
  LL_RCC_PLL_ConfigDomain_SYS(LL_RCC_PLLSOURCE_MSI, LL_RCC_PLLM_DIV_1, 45, LL_RCC_PLLR_DIV_4);
  LL_RCC_PLL_EnableDomain_SYS();
  LL_RCC_PLL_Enable();

   /* Wait till PLL is ready */
  while(LL_RCC_PLL_IsReady() != 1)
  {

  }
  LL_RCC_SetSysClkSource(LL_RCC_SYS_CLKSOURCE_PLL);

   /* Wait till System clock is ready */
  while(LL_RCC_GetSysClkSource() != LL_RCC_SYS_CLKSOURCE_STATUS_PLL)
  {

  }
  LL_RCC_SetAHBPrescaler(LL_RCC_SYSCLK_DIV_1);
  LL_RCC_SetAPB1Prescaler(LL_RCC_APB1_DIV_1);
  LL_RCC_SetAPB2Prescaler(LL_RCC_APB2_DIV_1);

  LL_Init1msTick(45000000);

  LL_SetSystemCoreClock(45000000);
}

static void MX_TIM2_Init(void)
{

  LL_TIM_InitTypeDef TIM_InitStruct = {0};

  /* Peripheral clock enable */
  LL_APB1_GRP1_EnableClock(LL_APB1_GRP1_PERIPH_TIM2);

  TIM_InitStruct.Prescaler = 449;
  TIM_InitStruct.CounterMode = LL_TIM_COUNTERMODE_UP;
  TIM_InitStruct.Autoreload = 9;
  TIM_InitStruct.ClockDivision = LL_TIM_CLOCKDIVISION_DIV1;
  LL_TIM_Init(TIM2, &TIM_InitStruct);
  LL_TIM_DisableARRPreload(TIM2);
  LL_TIM_SetClockSource(TIM2, LL_TIM_CLOCKSOURCE_INTERNAL);
  LL_TIM_SetTriggerOutput(TIM2, LL_TIM_TRGO_RESET);
  LL_TIM_DisableMasterSlaveMode(TIM2);
  /* USER CODE BEGIN TIM2_Init 2 */
	LL_TIM_EnableCounter(TIM2);
  /* USER CODE END TIM2_Init 2 */

}

static void MX_GPIO_Init(void)
{
  LL_GPIO_InitTypeDef GPIO_InitStruct = {0};

  /* GPIO Ports Clock Enable */
  LL_AHB2_GRP1_EnableClock(LL_AHB2_GRP1_PERIPH_GPIOC);
  LL_AHB2_GRP1_EnableClock(LL_AHB2_GRP1_PERIPH_GPIOH);

  /**/
  GPIO_InitStruct.Pin = PushButton_Pin;
  GPIO_InitStruct.Mode = LL_GPIO_MODE_INPUT;
  GPIO_InitStruct.Pull = LL_GPIO_PULL_UP;
  LL_GPIO_Init(PushButton_GPIO_Port, &GPIO_InitStruct);

}

/* USER CODE BEGIN 4 */
void delay_ms(uint32_t timeDelay)
{
    for (uint32_t i = 0; i < timeDelay; i++)
    {
        LL_TIM_SetCounter(TIM2, 0);
			  LL_TIM_EnableCounter(TIM2);
        while (!LL_TIM_IsActiveFlag_UPDATE(TIM2));
        LL_TIM_ClearFlag_UPDATE(TIM2);
    }
}

int ButtonPressed(void)
{
    if (!LL_GPIO_IsInputPinSet(GPIOC, LL_GPIO_PIN_13))
		{
        LL_mDelay(100);

        if (!LL_GPIO_IsInputPinSet(GPIOC, LL_GPIO_PIN_13))
        {
            return 1;
        }
    }
    return 0;  // Nút b?m chua nh?n
}
/* USER CODE END 4 */

void Error_Handler(void)
{
  __disable_irq();
  while (1)
  {
  }
}
